## boards/shields/skeletyl/Kconfig.defconfig
```kconfig
if SHIELD_SKELETYL_RIGHT

config ZMK_KEYBOARD_NAME
    default "Skeletyl"

config ZMK_SPLIT_ROLE_CENTRAL
    default y

endif

if SHIELD_SKELETYL_LEFT || SHIELD_SKELETYL_RIGHT

config ZMK_SPLIT
    default y

endif
```

## config/boards/shields/skeletyl/Kconfig.shield
```kconfig
config SHIELD_SKELETYL_LEFT
    def_bool $(shields_list_contain,skeletyl_left)

config SHIELD_SKELETYL_RIGHT
    def_bool $(shields_list_contain,skeletyl_right)
```

## config/west.yml
```yaml
manifest:
  remotes:
    - name: zmkfirmware
      url-base: https://github.com/zmkfirmware
    - name: urob
      url-base: https://github.com/urob
    - name: cyanindya
      url-base: https://github.com/cyanindya
  projects:
    - name: zmk
      remote: zmkfirmware
      revision: main
      import: app/west.yml
    - name: zmk-helpers
      remote: urob
      revision: main
    - name: zmk-keyboard-skeletyl-handwired
      remote: cyanindya
      revision: main
      # import: west.yml
  self:
    path: config
```
