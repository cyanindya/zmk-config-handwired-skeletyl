#include "skeletyl.dtsi"

// if you're using the Amoeba PCBs, you may want to put the GPIO_PULL_DOWN in the
// col-gpios instead

&kscan0 {
    row-gpios
        = <&pro_micro 19 (GPIO_ACTIVE_HIGH | GPIO_PULL_DOWN)> // row0
        , <&pro_micro 18 (GPIO_ACTIVE_HIGH | GPIO_PULL_DOWN)> // row1
        , <&pro_micro 15 (GPIO_ACTIVE_HIGH | GPIO_PULL_DOWN)> // row2
        , <&pro_micro 14 (GPIO_ACTIVE_HIGH | GPIO_PULL_DOWN)> // row3
        ; 
    col-gpios
        = <&pro_micro 8 (GPIO_ACTIVE_HIGH)> // col0
        , <&pro_micro 7 (GPIO_ACTIVE_HIGH)> // col1
        , <&pro_micro 6 (GPIO_ACTIVE_HIGH)> // col2
        , <&pro_micro 5 (GPIO_ACTIVE_HIGH)> // col3
        , <&pro_micro 4 (GPIO_ACTIVE_HIGH)> // col4
        ;
};